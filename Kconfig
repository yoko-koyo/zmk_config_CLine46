## Kconfig
```kconfig
config ZMK_INPUT_PROCESSOR_KEY_TAPPER
    bool "Input processor that taps behaviors based on relative movement"
    default y
    depends on ZMK_POINTING
    help
      トラックボール等の相対移動量を積算し、閾値を超えるたびに
      移動方向に対応した behavior をタップする input processor を有効にする。


config ZMK_INPUT_PROCESSOR_SCROLL_INERTIA
    bool "Input processor that adds inertia to scrolling"
    default y
    depends on ZMK_POINTING
    depends on DT_HAS_ZMK_INPUT_PROCESSOR_SCROLL_INERTIA_ENABLED
    help
      スクロールの速度を測り、入力が途切れたあとも減衰させながら
      スクロールを送り続ける (慣性スクロール) input processor を有効にする。
```

## dts/bindings/input_processors/zmk,input-processor-key-tapper.yaml
```yaml
# CLine46: 相対移動をキータップに変換する input processor

description: |
  相対入力(トラックボール等)の移動量をコードごとに積算し、threshold を
  超えるたびに移動方向に対応する behavior をタップする。

  bindings は codes 1つにつき2つ必要で、順に「負方向」「正方向」に対応する。
  例: codes = <INPUT_REL_X>; bindings = <&kp LC(LEFT) &kp LC(RIGHT)>;

compatible: "zmk,input-processor-key-tapper"

include: ip_zero_param.yaml

properties:
  type:
    type: int
    required: true
    description: 対象のイベントタイプ (例 INPUT_EV_REL)

  codes:
    type: array
    required: true
    description: 対象のイベントコード (例 INPUT_REL_X)

  threshold:
    type: int
    default: 250
    description: 1タップを発生させるのに必要な累積移動量

  tap-ms:
    type: int
    default: 10
    description: タップの押下時間(ms)

  wait-ms:
    type: int
    default: 10
    description: 次のタップまでの待ち時間(ms)

  bindings:
    type: phandle-array
    required: true
    description: codes 1つにつき「負方向」「正方向」の2つ
```

## dts/bindings/input_processors/zmk,input-processor-scroll-inertia.yaml
```yaml
# CLine46: スクロールに慣性をつける input processor

description: |
  スクロールイベント (REL_WHEEL / REL_HWHEEL) を記録して離す直前の速度を測り、
  入力が途切れたらその速度から減衰させながらスクロールを送り続ける。
  スクロール用 input-processors の中で、スクロールへの変換・反転の後、
  縮小 (scroll_runtime_input_processor) の前に置く。
  速度のしきい値は PC へ送るスクロール単位/秒。

compatible: "zmk,input-processor-scroll-inertia"

include: ip_zero_param.yaml

properties:
  divisor:
    type: int
    required: true
    description: 入力値を送信値に変換する割り算。後段の縮小 (scale-divisor) と同じ値にする

  release-ms:
    type: int
    default: 30
    description: 入力がこの時間途切れたら手を離したとみなし慣性を開始する (センサーの報告間隔 12ms より長く)

  window-ms:
    type: int
    default: 50
    description: 離す直前のこの時間の平均速度を慣性の初速にする

  min-stroke-ms:
    type: int
    default: 80
    description: これ以上続けて転がした時だけ慣性を付ける

  tick-ms:
    type: int
    default: 12
    description: 慣性スクロールの送信間隔

  decay:
    type: int
    default: 900
    description: tick ごとの速度の残存率 (千分率)。大きいほど長く滑る

  gain:
    type: int
    default: 1000
    description: 慣性開始時の速度倍率 (千分率)。1000 で離す直前と同じ速さから減速する

  start-velocity:
    type: int
    default: 20
    description: 離した瞬間の速度がこれ未満なら慣性を付けない (送信単位/秒)

  max-velocity:
    type: int
    default: 0
    description: 慣性の初速の上限 (送信単位/秒)。大きく弾いた時に滑りすぎるのを抑える。0 = 上限なし

  stop-velocity:
    type: int
    default: 3
    description: 速度がこれ未満になったら慣性を終了する (送信単位/秒)
```

## dts/bindings/input_processors/zmk,input-processor-trackball-scroll.yaml
```yaml
# CLine46: トラックボール用スクロール input processor

description: |
  センサーの生の REL_X / REL_Y をスクロール (REL_WHEEL / REL_HWHEEL) に変換する。
  加速・軸固定・端数処理・慣性をまとめて行うので、スクロール用 input-processors には
  これ1つだけを置く (code mapper や縮小は不要)。
  スクロール量の単位 "unit" は PC へ送るホイールの1段。

compatible: "zmk,input-processor-trackball-scroll"

include: ip_zero_param.yaml

properties:
  invert-x:
    type: boolean
    description: 横スクロールの向きを反転する

  invert-y:
    type: boolean
    description: 縦スクロールの向きを反転する

  slow-scale:
    type: int
    default: 150
    description: ゆっくり転がした時のスクロール量 (1カウントあたり milli-units。100 = 10カウントで1段)

  fast-scale:
    type: int
    default: 200
    description: 速く転がした時のスクロール量 (milli-units / count)

  half-speed:
    type: int
    default: 1500
    description: slow-scale と fast-scale のちょうど中間になる速度 (counts/sec)

  deadzone:
    type: int
    default: 4
    description: 動き出し・反転時に捨てる移動量 (counts)。軽く触れた時の揺れでスクロールしないようにする

  lock-margin:
    type: int
    default: 6
    description: 軸を切り替えるのに必要な差 (counts)。大きいほど斜めの動きで軸が変わりにくい

  release-ms:
    type: int
    default: 30
    description: 入力がこの時間途切れたら手を離したとみなす (センサーの報告間隔 12ms より長く)

  resume-ms:
    type: int
    default: 500
    description: 前の操作からこの時間内に同じ向きへ触り直したら続きとして扱う (端数を引き継ぎ、不感帯をかけない)

  window-ms:
    type: int
    default: 50
    description: 離す直前のこの時間の平均速度を慣性の初速にする

  min-stroke-ms:
    type: int
    default: 40
    description: これ以上続けて転がした時だけ慣性を付ける

  tick-ms:
    type: int
    default: 12
    description: 慣性スクロールの送信間隔

  inertia-tau-ms:
    type: int
    default: 120
    description: 慣性の減速の時定数。滑る距離はおおよそ 初速 × この時間。0 に近いほどすぐ止まる

  start-velocity:
    type: int
    default: 5
    description: 慣性の初速は「離す直前の速度 - これ」(units/sec)。遅い動きほど控えめに滑り、これ未満なら滑らない

  quick-velocity:
    type: int
    default: 30
    description: 初速がこれ (units/sec) 未満の慣性は、滑る距離を保ったまま時間を縮めて素早く滑り終える (小さい慣性の遅れをなくす)。0 で無効

  max-velocity:
    type: int
    default: 60
    description: 慣性の初速の上限 (units/sec)。0 = 上限なし

  stop-velocity:
    type: int
    default: 1
    description: 速度がこれ未満になったら慣性を終了する (units/sec)
```
